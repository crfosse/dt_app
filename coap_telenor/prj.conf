## Kconfig
```
menu "Application"

module = APP
module-dep = LOG
module-str = Log level for application
source "${ZEPHYR_BASE}/subsys/logging/Kconfig.template.log_config"

config LTE_PTW_VALUE
	string "Paging Time Window"
	default "0011"

endmenu

menu "Zephyr Kernel"
source "$ZEPHYR_BASE/Kconfig.zephyr"
endmenu
```

## prj.conf
```kconfig
# General config
CONFIG_ASSERT=n #Consumes a lot of power. 
CONFIG_TEST_RANDOM_GENERATOR=n

# Logging
CONFIG_SERIAL=n
CONFIG_LOG=y
CONFIG_LOG_STRDUP_MAX_STRING=64
CONFIG_APP_LOG_LEVEL_DBG=y 
CONFIG_LTE_LINK_CONTROL_LOG_LEVEL_INF=y
CONFIG_COAP_LOG_LEVEL_DBG=y

# AT Host
CONFIG_UART_INTERRUPT_DRIVEN=y
CONFIG_AT_HOST_LIBRARY=y

# Network
CONFIG_NETWORKING=y
CONFIG_NET_SOCKETS=y
CONFIG_NET_SOCKETS_OFFLOAD=y

# BSD library
CONFIG_BSD_LIBRARY=y

# LTE link control
CONFIG_LTE_LINK_CONTROL=y
CONFIG_LTE_AUTO_INIT_AND_CONNECT=n
CONFIG_LTE_NETWORK_MODE_NBIOT=n
CONFIG_LTE_PDP_CMD=y
CONFIG_LTE_PDP_CONTEXT="0,\"IP\",\"mda.ee\""

#PSM test
CONFIG_LTE_PSM_REQ_RPTAU="10100101" #5 min
CONFIG_LTE_PSM_REQ_RAT="00000000"   #0 min

CONFIG_LTE_EDRX_REQ=n
CONFIG_LTE_EDRX_REQ_VALUE="0000" 
CONFIG_LTE_PTW_VALUE="0001"
#CONFIG_MODEM_INFO=n

# CoAP
CONFIG_COAP=y

# Heap and stacks
CONFIG_HEAP_MEM_POOL_SIZE=16384
CONFIG_MAIN_STACK_SIZE=8192
CONFIG_SYSTEM_WORKQUEUE_STACK_SIZE=2048
CONFIG_HW_STACK_PROTECTION=y

# Library for buttons and LEDs
CONFIG_DK_LIBRARY=y

# Disable native network stack to save some memory
CONFIG_NET_IPV4=n
CONFIG_NET_IPV6=n
CONFIG_NET_UDP=n
CONFIG_NET_TCP=n
CONFIG_NET_RX_STACK_SIZE=1024  
CONFIG_NET_TX_STACK_SIZE=1024

# Uncomment the lines below to disable optimizations when debugging
CONFIG_NO_OPTIMIZATIONS=n
CONFIG_DEBUG=n
```

## src/main.c
```c
#include <zephyr.h>
#include <logging/log.h>

#include <dk_buttons_and_leds.h>
#include <lte_lc.h>

#include "coap.h"

LOG_MODULE_REGISTER(app_main, CONFIG_APP_LOG_LEVEL);

/* Application settings */
#define WITH_PSM
#define TEST_PERIODIC
//#define TEST_SWEEP

/* Test settings */
#define SAMPLE_INTERVAL      1 //Seconds
#define SWEEP_INTERVAL      40 //Seconds
#define SIZE_STEP           41 //1435 bytes is max, so we get as close to the limit as possible.
#define MAX_SAMPLES          5
#define PERIODIC_MSG_SIZE 1280 //Bytes

// The periodic TAU given by the network
static int actual_tau; 

/* Indicates when the application is ready to transmit *
*  according to the periodic TAU					   */
static bool transmit = false;

// Size is restricted my MTU
#define TEST_DATA_SIZE 1439

//1440 random characters in an array for upload testing
u8_t * testData = "yK3vQHgUQ1WBUNPGprMSh0o1ZOTpGzC788DMB0OoQytSTDmKo7zeybWdx1DGh3SX"
				  "IpfkYHSkX3hQuEUdWC8jWBq6qRAzv4NB79aECZwwUsReylQcJOzZ4NW1rY3xbyya"
				  "ep9DOEWnRsWkjILrSh4crLHlfvmqVLxRjA1dDvHx72JVD4rvhhLbcQ6Gi94lvVF7"
				  "0KmnO4Lh7IRGUm37TVXzQXtRnb228WPngoCC5Ge4GZNmBRFhXWtgeuU9Vt2JJbID"
				  "jvdEpZVL88RszUn7Ah4pnTC7rkHRft6apfuZCUqo0udcvNbEaUFncwjsU8zkw8j7"
				  "mfiD7QxF2A9Kv7XTztxef2Ryj1MbWe0vDAPXUz3yb4AqfgcxPb3TCocDCgAd2F2S"
				  "xlAZ69913oxzD0M24Sl0YIztsCnTuUrzrgIOrdXWvjOcEcuEJltiIZMygVx8gxwc"
				  "pwY4YNybojiLfuRET4w91tbTgn33IvFcY8J7tu5Y8LZjk5ZfkekJg5zhZs6Bo2Jm"
				  "N0mC7eCqYvSBGm4No2TPbLjYD2fB5ERubVuo2rGeZjbnWEx8jcP9jgq049pEjjS9"
				  "MRXvJnDtpo8hIZcZpz1HKyXbOXbz60baSbpW5RHOhwg1TBh8wrBTOOORMMCBhl4O"
				  "QApYjcf2w4ZlbyfWUjQY6gkGR21599Wb1IjraQL911QeFjiRFGtcDEpxo5GMWL1O"
				  "ZKM4Gnkp4LP0A0yK9FlHeopsaCOBxOI0dTaq2gWDD8rRRCbYykck0J5IZfQnrBbv"
            	  "AH1MSzQuBq5BLjPC6KhWj519pymLg11fSvhgWlOnhfuSNlmqq9pysYmZIPUNKGOP"
				  "9gfpEKm8tCuvpUWZvoFsrmxfYQNe9vUznG0PZMhHDSc5C6wDBpFqDBhHEHRdg0KR"
				  "Df8CU5RsaaviBtI8yFb0plaRQjzTYg2xZcppX4NANeqB0udVdEdfhIxX6iVXcEb5"
				  "lGY0a35dDRjCgL7ePgZn7oQbLuusUurDbprEu2msxDXz94KJPwhnMldretN5bgq7"
				  "yK3vQHgUQ1WBUNPGprMSh0o1ZOTpGzC788DMB0OoQytSTDmKo7zeybWdx1DGh3SX"
				  "IpfkYHSkX3hQuEUdWC8jWBq6qRAzv4NB79aECZwwUsReylQcJOzZ4NW1rY3xbyya"
				  "ep9DOEWnRsWkjILrSh4crLHlfvmqVLxRjA1dDvHx72JVD4rvhhLbcQ6Gi94lvVF7"
				  "0KmnO4Lh7IRGUm37TVXzQXtRnb228WPngoCC5Ge4GZNmBRFhXWtgeuU9Vt2JJbID"
				  "jvdEpZVL88RszUn7Ah4pnTC7rkHRft6apfuZCUqo0udcvNbEaUFncwjsU8zkw8j7"
				  "mfiD7QxF2A9Kv7XTztxef2Ryj1MbWe0vDAPXUz3yb4AqfgcxPb3TCocDCgAd2F2S"
				  "xlAZ69913oxk5ZfkekJg5zhZs6Bo2Ja";


/* @brief Message post function derived from Telenor's code */
static int message_post(struct coap_resource *resource, struct coap_packet *request, struct sockaddr *addr, socklen_t addr_len) {
	coap_endpoint *coap = resource->user_data;

	u16_t payload_len;
	const u8_t *payload = coap_packet_get_payload(request, &payload_len);

	u8_t *buf = k_calloc(payload_len + 1, 1);
	memcpy(buf, payload, payload_len);
	LOG_INF("Received CoAP POST: %s", log_strdup(buf));
	k_free(buf);
 
	int err = coap_endpoint_respond(coap, request, COAP_RESPONSE_CODE_CREATED, NULL, 0, addr, addr_len);
	if (err != 0) {
		LOG_ERR("coap_endpoint_respond: %d", err);
	}

	return 0;
}

/* @brief Used to instantiate different variables needed for CoAP operation */
void init_endpoint(void) {
	struct sockaddr_in local_addr = {
		.sin_family = AF_INET,
		.sin_port = htons(5683),
	};
	coap = coap_endpoint_init((struct sockaddr *)&local_addr, sizeof(local_addr), resources);
	if (coap == NULL) {
		LOG_ERR("coap_endpoint_init");
		return;
	}

	resources[0].user_data = coap;

	// Telenor's IP address.
	net_addr_pton(AF_INET, "172.16.15.14", &remote_addr.sin_addr);
}

static const char * const message_path[] = { "message", NULL };
static struct coap_resource resources[] = {
	{
		path: message_path,
		post: message_post,
	},
	{},
};
static coap_endpoint *coap;
struct sockaddr_in 	remote_addr = {
		.sin_family = AF_INET,
		.sin_port = htons(5683),
};
static const char * const path[] = { "straight", "and", "narrow", NULL };


/**@brief Callback for button events from the DK buttons and LEDs library. */
static void button_handler(u32_t button_states, u32_t has_changed)
{
	 static size_t test_index = 0;
	 
	if (has_changed & button_states & DK_BTN1_MSK) {
		LOG_INF("DEV_DBG: button 1 pressed\n");
		LOG_INF("Current test_index: %d", test_index);
		if(test_index <= TEST_DATA_SIZE) {
				int ret = coap_endpoint_post(coap, (struct sockaddr *)&remote_addr, sizeof(remote_addr), path, testData, test_index);
				if (ret != COAP_RESPONSE_CODE_CREATED) {
					LOG_ERR("coap_endpoint_post: %d", ret);
					return;
				}
			test_index += 10;
		} else {
			test_index = 0;
		}
	}
	else if (has_changed & button_states & DK_BTN2_MSK) {
		//resetting the test
		test_index = 0;
	}
	return;
}

/**@brief Configures modem to provide LTE link. Blocks until link is
 * successfully established.
 */
static void modem_configure(void)
{
#if defined(CONFIG_LTE_LINK_CONTROL)
	if (IS_ENABLED(CONFIG_LTE_AUTO_INIT_AND_CONNECT)) {
		/* Do nothing, modem is already turned on
		 * and connected.
		 */
	} else {
		int err;

		LOG_INF("LTE Link Connecting ...\n");
		err = lte_lc_init_and_connect();
		__ASSERT(err == 0, "LTE link could not be established.");
		LOG_INF("LTE Link Connected!\n");
	}
#endif /* defined(CONFIG_LTE_LINK_CONTROL) */
}

/**@brief Initializes buttons and LEDs, using the DK buttons and LEDs
 * library.
 */
static void buttons_leds_init(void)
{
	int err;

	LOG_INF("DEV_DBG: Initalizing buttons and leds.\n");

	err = dk_buttons_init(button_handler);
	if (err) {
		LOG_ERR("Could not initialize buttons, err code: %d\n", err);
	}

	err = dk_leds_init();
	if (err) {
		LOG_ERR("Could not initialize leds, err code: %d\n", err);
	}

	err = dk_set_leds_state(DK_ALL_LEDS_MSK, DK_NO_LEDS_MSK);
	if (err) {
		LOG_ERR("Could not set leds state, err code: %d\n", err);
	}
}

void setup_psm(void)
{
	/*
	* GPRS Timer 3 value (octet 3)
	*
	* Bits 5 to 1 represent the binary coded timer value.
	*
	* Bits 6 to 8 defines the timer value unit for the GPRS timer as follows:
	* Bits 
	* 8 7 6
	* 0 0 0 value is incremented in multiples of 10 minutes 
	* 0 0 1 value is incremented in multiples of 1 hour 
	* 0 1 0 value is incremented in multiples of 10 hours
	* 0 1 1 value is incremented in multiples of 2 seconds
	* 1 0 0 value is incremented in multiples of 30 seconds
	* 1 0 1 value is incremented in multiples of 1 minute
	* 1 1 0 value is incremented in multiples of 320 hours (NOTE 1)
	* 1 1 1 value indicates that the timer is deactivated (NOTE 2).
	*/
	char psm_settings[] = CONFIG_LTE_PSM_REQ_RPTAU;
	printk("PSM bits: %c%c%c\n", psm_settings[0], psm_settings[1],
	       psm_settings[2]);
	printk("PSM Interval: %c%c%c%c%c\n", psm_settings[3], psm_settings[4],
	       psm_settings[5], psm_settings[6], psm_settings[7]);
	int err = lte_lc_psm_req(true);
	if (err < 0) {
		printk("Error setting PSM: %d Errno: %d\n", err, errno);
	}
}

/* Timer used during TEST_PERIODIC to initiate transmission at the designated interval */
void app_timer_handler(struct k_timer *dummy)
{
	static u32_t minutes;

	minutes++;
	/* This shall match the PSM interval*/
	if (minutes % actual_tau == 0) {
		transmit = true;
		LOG_INF("Ready for transmit");
	}
	LOG_INF("Elapsed time: %d\n", minutes);
}

K_TIMER_DEFINE(app_timer, app_timer_handler, NULL);

/* @brief initializes timer that triggers every minute */
void timer_init(void)
{
	k_timer_start(&app_timer, K_MINUTES(1), K_MINUTES(1));
}


#ifdef TEST_PERIODIC
static int run_periodic(void) {
	static u8_t sample_cnt = 1;
	static bool transmit_finished = false;
	
		if (transmit) {
			//Lighting LED2 to indicate that transmission is initiated
			dk_set_led(DK_LED2, 0);

			//Data upload
			int ret = coap_endpoint_post(coap, (struct sockaddr *)&remote_addr, sizeof(remote_addr), path, testData, PERIODIC_MSG_SIZE);
			if (ret != COAP_RESPONSE_CODE_CREATED) {
				LOG_ERR("coap_endpoint_post: %d", ret);
				return -1;
			}
			transmit_finished = true;			
		}

		k_sleep(K_SECONDS(SAMPLE_INTERVAL));

		if(transmit && transmit_finished) {
			//Transmission phase over.
			dk_set_led(DK_LED2, 1);
			transmit = false;
			transmit_finished = false;

			if(sample_cnt >= MAX_SAMPLES) {
				//exit test
				return -1;
			}

			sample_cnt++;
		}

		return 0;
}

#endif

#ifdef TEST_SWEEP
static int run_size_sweep(void) {
	static size_t test_index = 0;

	LOG_INF("Current test_index: %d", test_index);
	int ret = coap_endpoint_post(coap, (struct sockaddr *)&remote_addr, sizeof(remote_addr), path, testData, test_index);
	if (ret != COAP_RESPONSE_CODE_CREATED) {
		LOG_ERR("coap_endpoint_post: %d", ret);
		return -1;
	}
	test_index += SIZE_STEP;

	if(test_index > TEST_DATA_SIZE) {
		//ending test
		return -1;
	}

	return 0;
}
#endif

void main() {
	LOG_INF("\nDT CoAP application example started\n");
	
	int err;
	
	buttons_leds_init();

	#ifdef WITH_PSM
	setup_psm();
	#else
	/* Force PSM off in case the modem uses old PSM settings */
	err = lte_lc_psm_req(false);
	#endif


	modem_configure();

	init_endpoint();

	#ifdef WITH_PSM

	// The network can provide other PSM values. So we fetch the actual values of the network 
	int curr_active;
	lte_lc_psm_get(&actual_tau, &curr_active);
	LOG_INF("Reqested: TAU = %s | AT = %s", log_strdup(CONFIG_LTE_PSM_REQ_RPTAU), log_strdup(CONFIG_LTE_PSM_REQ_RAT));
	LOG_INF("Got: TAU = %d | AT = %d", actual_tau, curr_active);
	#endif

	#ifdef TEST_PERIODIC
	// Converting TAU to minutes
	actual_tau = actual_tau/60;
	timer_init();
	#endif

	#ifdef TEST_SWEEP
		k_sleep(K_SECONDS(SWEEP_INTERVAL));
	#endif

	//Lighting LED1 to indicate that the application is connected and entering main loop.
	dk_set_led(DK_LED1, 0);
	while(1) {
		#ifdef TEST_PERIODIC
			err = run_periodic();
			if (err < 0) {
				dk_set_led(DK_LED3, 0);
				LOG_ERR("Error or finished sweep");
				return;
			}
			k_sleep(K_SECONDS(SAMPLE_INTERVAL));
		#elif defined(TEST_SWEEP)
			dk_set_led(DK_LED2, 0);
			if (run_size_sweep() < 0) {
				dk_set_led(DK_LED3, 0);
				LOG_ERR("Error or finished sweep");
				return;
			}
			dk_set_led(DK_LED2, 1);
			k_sleep(SWEEP_INTERVAL);
		#else
			k_sleep(K_SECONDS(SAMPLE_INTERVAL));
		#endif
	}
}
```

## src/coap.c
```c
#include <zephyr.h>

#include <logging/log.h>
#include <net/socket.h>
#include <net/net_mgmt.h>
#include <net/net_ip.h>
#include <net/udp.h>
#include <net/coap.h>

#include "coap.h"

LOG_MODULE_REGISTER(app_coap, CONFIG_APP_LOG_LEVEL);

#define MAX_COAP_MSG_LEN 1472 //With 20 bytes of options this indicates the biggest possible CoAP packet. Including headers, token, options and payload. Given an MTU of 1500, with IPv4 and UDP overhead. 
#define MAX_COAP_OPTIONS 16 //This is maximum received options. 

#define RECV_THREAD_STACK_SIZE 1024
#define RECV_THREAD_PRIORITY -1

// An inflight_packet represents a packet that has not been acknowledged (and not responded to, if it is a request).
// This struct takes ownership of the packet and is responsible for freeing it.
typedef struct {
	bool retransmit;
	struct coap_packet packet;
	struct sockaddr addr;
	socklen_t addr_len;
	u8_t retransmission_count;
	s32_t timeout, deadline;

	coap_response_handler response_handler;
	void *response_handler_data;
} inflight_packet;

typedef struct _coap_endpoint {
	int sock;
	struct coap_resource *resources;
	inflight_packet *inflight_packets;
	size_t inflight_packets_len;
} coap_endpoint;

static K_FIFO_DEFINE(tx_fifo);
static K_FIFO_DEFINE(rx_fifo);

typedef struct {
	void *fifo_reserved;
	struct coap_packet packet;
	struct sockaddr addr;
	socklen_t addr_len;
	coap_response_handler response_handler;
	void *response_handler_data;
} packet_tx_data_item;

typedef struct {
	void *fifo_reserved;
	u8_t data[MAX_COAP_MSG_LEN];
	struct coap_packet packet;
	struct coap_option options[MAX_COAP_OPTIONS];
	struct sockaddr addr;
	socklen_t addr_len;
} packet_rx_data_item;

static void recv_thread(void *p1, void *p2, void *p3) {
	int sock = (int)p1;
	
	while (true) {
		packet_rx_data_item *rx = k_calloc(1, sizeof(packet_rx_data_item));
		if (!rx) {
			LOG_ERR("unable to allocate memory for packet");
			return;
		}
		rx->addr_len = sizeof(rx->addr);

		int len = recvfrom(sock, rx->data, sizeof(rx->data), 0, &rx->addr, &rx->addr_len);
		if (len < 0) {
			LOG_ERR("recvfrom: %d", errno);
			return;
		}

		LOG_DBG("Options size: %d", sizeof(rx->options));

		int err = coap_packet_parse(&rx->packet, rx->data, sizeof(rx->data), rx->options, MAX_COAP_OPTIONS);
		if (err < 0) {
			LOG_ERR("coap_packet_parse: %d", err);
			k_free(rx);
			continue;
		}

		k_fifo_put(&rx_fifo, rx);
	}
}

K_THREAD_STACK_DEFINE(recv_thread_stack_area, RECV_THREAD_STACK_SIZE);
static struct k_thread recv_thread_data;
static k_tid_t recv_thread_tid;

// new_inflight_packet creates a new inflight_packet, taking ownership of the packet if it is confirmable.
static inflight_packet *new_inflight_packet(coap_endpoint *ep, packet_tx_data_item *tx) {
	inflight_packet *new_inflight_packets = k_calloc(ep->inflight_packets_len + 1, sizeof(inflight_packet));
	if (new_inflight_packets == NULL) {
		return NULL;
	}
	memcpy(new_inflight_packets, ep->inflight_packets, ep->inflight_packets_len * sizeof(inflight_packet));
	k_free(ep->inflight_packets);
	ep->inflight_packets = new_inflight_packets;
	ep->inflight_packets_len++;

	inflight_packet *inflight = &ep->inflight_packets[ep->inflight_packets_len - 1];
	if (coap_header_get_type(&tx->packet) == COAP_TYPE_CON) {
		inflight->retransmit = true;
		inflight->packet = tx->packet;
		inflight->addr = tx->addr;
		inflight->addr_len = tx->addr_len;
		inflight->retransmission_count = 0;
		inflight->timeout = K_SECONDS(10) + sys_rand32_get() % K_SECONDS(1);
		inflight->deadline = k_uptime_get_32() + inflight->timeout;
	}
	inflight->response_handler = tx->response_handler;
	inflight->response_handler_data = tx->response_handler_data;
	return inflight;
}

static void free_inflight_packet(coap_endpoint *ep, inflight_packet *inflight) {
	k_free(inflight->packet.data);
	for (int i = 0; i < ep->inflight_packets_len; i++) {
		if (&ep->inflight_packets[i] == inflight) {
			ep->inflight_packets_len--;
			ep->inflight_packets[i] = ep->inflight_packets[ep->inflight_packets_len];
			return;
		}
	}
}

// next_retransmission returns the inflight packet with the earliest retransmission deadline, or NULL.
static inflight_packet *next_retransmission(coap_endpoint *ep) {
	inflight_packet *next = NULL;
	for (size_t i = 0; i < ep->inflight_packets_len; i++) {
		inflight_packet *inflight = &ep->inflight_packets[i];
		if (inflight->retransmit && (next == NULL || inflight->deadline < next->deadline)) {
			next = inflight;
		}
	}

	return next;
}

#define COAP_CODE_CLASS_MASK (7<<5)

static bool is_request(const struct coap_packet *p) {
	u8_t code = coap_header_get_code(p);
	return (code & COAP_CODE_CLASS_MASK) == 0 && code != COAP_CODE_EMPTY;
}

static bool is_response(const struct coap_packet *p) {
	u8_t code = coap_header_get_code(p);
	return (code & COAP_CODE_CLASS_MASK) != 0;
}

// get_inflight_packet searches for an inflight packet that has a matching address and a matching id or token.
static inflight_packet *get_inflight_packet(coap_endpoint *ep, packet_rx_data_item *rx) {
	u16_t id = coap_header_get_id(&rx->packet);
	u8_t token[8];
	u8_t token_len = coap_header_get_token(&rx->packet, token);

	for (size_t i = 0; i < ep->inflight_packets_len; i++) {
		inflight_packet *inflight = &ep->inflight_packets[i];
		u8_t tok[8];
		bool addrs_equal = inflight->addr_len == rx->addr_len && memcmp(&inflight->addr, &rx->addr, rx->addr_len) == 0;
		bool ids_equal = coap_header_get_id(&inflight->packet) == id;
		bool tokens_equal = coap_header_get_token(&inflight->packet, tok) == token_len && memcmp(tok, token, token_len) == 0;

		if (addrs_equal && (ids_equal || tokens_equal)) {
			return inflight;
		}
	}

	return NULL;
}

// transmit_packet sends a packet for the first time (not a retransmission).
// It transfers ownership of the packet to an inflight_packet or frees it.
static void transmit_packet(packet_tx_data_item *tx, coap_endpoint *ep, int sock) {
	inflight_packet *inflight = new_inflight_packet(ep, tx);
	if (inflight == NULL) {
		tx->response_handler(tx->response_handler_data, -ENOMEM, NULL);
		k_free(tx->packet.data);
		return;
	}

	LOG_DBG("DEV - data size: %d", sizeof(tx->packet.data));
	LOG_DBG("DEV - offset size: %d", sizeof(tx->packet.offset));
	

	if (sendto(sock, tx->packet.data, tx->packet.offset, 0, &tx->addr, tx->addr_len) < 0) {
		LOG_ERR("sendto: %d", errno);
	}

	LOG_DBG("DEV: packet transmitted.");

	if (coap_header_get_type(&tx->packet) != COAP_TYPE_CON) {
		k_free(tx->packet.data);
		tx->packet.data = NULL;
		if (!is_request(&tx->packet)) {
			free_inflight_packet(ep, inflight);
		}
	}
}

// retransmit_packet retransmits a packet, or signals an error and frees packet.data if the maximum number of retransmissions is exceeded.
static void retransmit_packet(coap_endpoint *ep, inflight_packet *inflight) {
	inflight->retransmission_count++;
	inflight->timeout *= 2;
	inflight->deadline += inflight->timeout;

	const u8_t max_retransmission_count = 4;
	if (inflight->retransmission_count > max_retransmission_count) {
		inflight->response_handler(inflight->response_handler_data, -EAGAIN, NULL);
		free_inflight_packet(ep, inflight);
		return;
	}

	if (sendto(ep->sock, inflight->packet.data, inflight->packet.offset, 0, &inflight->addr, inflight->addr_len) < 0) {
		LOG_ERR("sendto: %d", errno);
	}

	LOG_DBG("DEV: packet retransmitted.");
}

static enum coap_response_code response_code_for_error(int err) {
	switch (-err) {
	case ENOENT:
		return COAP_RESPONSE_CODE_NOT_FOUND;
	case EPERM:
		return COAP_RESPONSE_CODE_NOT_ALLOWED;
	case EINVAL:
		return COAP_RESPONSE_CODE_BAD_REQUEST;
	}
	return COAP_RESPONSE_CODE_INTERNAL_ERROR;
}

static void receive_packet(coap_endpoint *ep, packet_rx_data_item *rx) {
	// TODO: Optionally detect duplicate packets (retransmissions) and deal with them in the same way as the orignal transmission.

	if (is_request(&rx->packet)) {
		int err = coap_handle_request(&rx->packet, ep->resources, rx->options, MAX_COAP_OPTIONS, &rx->addr, rx->addr_len);
		if (err != 0) {
			int err = coap_endpoint_respond(ep, &rx->packet, response_code_for_error(err), NULL, 0, &rx->addr, rx->addr_len);
			if (err != 0) {
				LOG_ERR("coap_endpoint_respond: %d", err);
				return;
			}
		}
		return;
	}

	inflight_packet *inflight = get_inflight_packet(ep, rx);
	if (inflight != NULL) {
		if (coap_header_get_type(&rx->packet) == COAP_TYPE_RESET) {
			inflight->response_handler(inflight->response_handler_data, -ECANCELED, NULL);
			free_inflight_packet(ep, inflight);
			return;
		}

		if (is_response(&rx->packet)) {
			inflight->response_handler(inflight->response_handler_data, 0, &rx->packet);
			free_inflight_packet(ep, inflight);
			return;
		}

		// At this point we know rx->packet is neither a request, a response, nor a reset, so it must be an empty acknowledgment.

		if (is_request(&inflight->packet)) {
			inflight->retransmit = false;
			return;
		}

		if (is_response(&inflight->packet)) {
			free_inflight_packet(ep, inflight);
			return;
		}
	}

	// rx->packet is not a request nor did it match any inflight packets.
	// We should reject it so that it is not retransmitted.  It may be a ping.
	if (coap_header_get_type(&rx->packet) == COAP_TYPE_CON) {
		int err = coap_endpoint_reset(ep, &rx->packet, &rx->addr, rx->addr_len);
		if (err != 0) {
			LOG_ERR("coap_endpoint_reset: %d", err);
		}
		return;
	}
}

// txrx_thread transmits, retransmits, and receives packets.
// Packets to be sent are passed to this thread via tx_fifo.
// Packets are received in another thread and passed to this one via rx_fifo.
// The separate receiving thread is necessary because it is not possible to use k_poll with both sockets and FIFOs.
static void txrx_thread(void *p1, void *p2, void *p3) {
	coap_endpoint *ep = p1;

	recv_thread_tid = k_thread_create(
		&recv_thread_data, recv_thread_stack_area, K_THREAD_STACK_SIZEOF(recv_thread_stack_area),
		recv_thread,
		(void *)ep->sock, NULL, NULL,
		RECV_THREAD_PRIORITY, 0, K_NO_WAIT);
	if (recv_thread_tid <= 0) {
		LOG_ERR("k_thread_create failed");
		return;
	}

	struct k_poll_event events[2] = {
	    K_POLL_EVENT_STATIC_INITIALIZER(K_POLL_TYPE_FIFO_DATA_AVAILABLE, K_POLL_MODE_NOTIFY_ONLY, &tx_fifo, 0),
	    K_POLL_EVENT_STATIC_INITIALIZER(K_POLL_TYPE_FIFO_DATA_AVAILABLE, K_POLL_MODE_NOTIFY_ONLY, &rx_fifo, 0),
	};

	while (true) {
		s32_t timeout = K_FOREVER;
		inflight_packet *retransmission = next_retransmission(ep);
		if (retransmission != NULL) {
			timeout = retransmission->deadline - k_uptime_get_32();
		}

		int ret = k_poll(events, sizeof(events)/sizeof(struct k_poll_event), timeout);
		if (ret == -EAGAIN) {
			retransmit_packet(ep, retransmission);
		} else if (ret == 0) {
			if (events[0].state == K_POLL_STATE_FIFO_DATA_AVAILABLE) {
				events[0].state = K_POLL_STATE_NOT_READY;

				packet_tx_data_item *tx = k_fifo_get(&tx_fifo, K_FOREVER);
				transmit_packet(tx, ep, ep->sock);
				k_free(tx);
			}
			if (events[1].state == K_POLL_STATE_FIFO_DATA_AVAILABLE) {
				events[1].state = K_POLL_STATE_NOT_READY;

				packet_rx_data_item *rx = k_fifo_get(&rx_fifo, K_FOREVER);
				receive_packet(ep, rx);
				k_free(rx);
			}
		} else {
			LOG_ERR("k_poll: %d", ret);
			continue;
		}
	}

	close(ep->sock);
}

#define TXRX_THREAD_STACK_SIZE 2048
#define TXRX_THREAD_PRIORITY -1
K_THREAD_STACK_DEFINE(txrx_thread_stack_area, TXRX_THREAD_STACK_SIZE);
static struct k_thread txrx_thread_data;
static k_tid_t txrx_thread_tid = 0;

coap_endpoint *coap_endpoint_init(struct sockaddr *local_addr, socklen_t local_addr_len, struct coap_resource *resources) {
	if (txrx_thread_tid != 0) {
		LOG_ERR("only a single CoAP ep is supported at this time");
		return NULL;
	}
	
	coap_endpoint *ep = k_calloc(1, sizeof(coap_endpoint));
	if (!ep) {
		return NULL;
	}

	ep->resources = resources;

	ep->sock = socket(local_addr->sa_family, SOCK_DGRAM, IPPROTO_UDP);
	if (ep->sock < 0) {
		LOG_ERR("socket: %d", errno);
		return NULL;
	}

	int ret = bind(ep->sock, local_addr, local_addr_len);
	if (ret < 0) {
		LOG_ERR("bind: %d", errno);
		close(ep->sock);
		return NULL;
	}

	txrx_thread_tid = k_thread_create(
		&txrx_thread_data, txrx_thread_stack_area, K_THREAD_STACK_SIZEOF(txrx_thread_stack_area),
		txrx_thread,
		ep, NULL, NULL,
		TXRX_THREAD_PRIORITY, 0, K_NO_WAIT);
	if (txrx_thread_tid <= 0) {
		LOG_ERR("k_thread_create failed");
		return NULL;
	}

	return ep;
}


typedef struct {
	coap_endpoint *ep;
	struct k_sem sem;
	int ret;
	struct sockaddr *addr;
	socklen_t addr_len;
} post_handler_data;

void post_handler(void *p, int err, struct coap_packet *response) {
	post_handler_data *data = p;
	if (err) {
		data->ret = err;
	} else {
		data->ret = coap_header_get_code(response);

		LOG_DBG("Got response: %d", coap_header_get_type(response));

		err = coap_endpoint_acknowledge(data->ep, response, data->addr, data->addr_len);
		if (err != 0) {
			LOG_ERR("coap_endpoint_acknowledge: %d", err);
		}
	}

	k_sem_give(&data->sem);
}

int coap_endpoint_post(coap_endpoint *ep, struct sockaddr *addr, socklen_t addr_len, const char *const *path, u8_t *payload, int payload_len) {
	post_handler_data post_handler_data = {
		ep: ep,
		addr: addr,
		addr_len: addr_len,
	};
	k_sem_init(&post_handler_data.sem, 0, 1);

	int err = coap_endpoint_post_async(ep, addr, addr_len, path, payload, payload_len, post_handler, &post_handler_data);
	if (err != 0) {
		LOG_ERR("coap_endpoint_post_async: %d", err);
		return err;
	}

	k_sem_take(&post_handler_data.sem, K_FOREVER);
	return post_handler_data.ret;
}

int coap_endpoint_post_async(coap_endpoint *ep, struct sockaddr *addr, socklen_t addr_len, const char *const *path, u8_t *payload, int payload_len, coap_response_handler response_handler, void *response_handler_data) {
	u8_t *data = k_calloc(1, MAX_COAP_MSG_LEN);
	if (!data) {
		return -ENOMEM;
	}

	packet_tx_data_item *tx = k_calloc(1, sizeof(packet_tx_data_item));
	if (!tx) {
		k_free(data);
		return -ENOMEM;
	}

	tx->addr = *addr;
	tx->addr_len = addr_len;
	tx->response_handler = response_handler;
	tx->response_handler_data = response_handler_data;

	int err;



	err = coap_packet_init(&tx->packet, data, MAX_COAP_MSG_LEN, 1, COAP_TYPE_CON, 8, coap_next_token(), COAP_METHOD_POST, coap_next_id());
	if (err < 0) {
		LOG_ERR("coap_packet_init: %d", err);
		goto error;
	}


	for (const char *const *p = path; p && *p; p++) {
		err = coap_packet_append_option(&tx->packet, COAP_OPTION_URI_PATH, *p, strlen(*p));
		if (err < 0) {
			LOG_ERR("coap_packet_append_option: %d", err);
			goto error;
		}
		LOG_DBG("DEV - appending option");
		LOG_DBG("DEV - opt_len: %d", *(&tx->packet.opt_len));
	}

	if (payload != NULL && payload_len > 0) {
		err = coap_packet_append_payload_marker(&tx->packet);
		if (err < 0) {
			LOG_ERR("coap_packet_append_payload_marker: %d", err);
			goto error;
		}

		err = coap_packet_append_payload(&tx->packet, payload, payload_len);
		if (err < 0) {
			LOG_ERR("coap_packet_append_payload: %d", err);
			goto error;
		}
	}


	k_fifo_put(&tx_fifo, tx);

	return 0;

error:
	k_free(tx);
	k_free(data);

	return err;
}

int coap_endpoint_acknowledge(coap_endpoint *ep, struct coap_packet *packet, struct sockaddr *addr, socklen_t addr_len) {
	if (coap_header_get_type(packet) != COAP_TYPE_CON) {
		return 0;
	}

	struct coap_packet ack;
	u8_t data[4];
	int err = coap_packet_init(&ack, data, sizeof(data), 1, COAP_TYPE_ACK, 0, NULL, COAP_CODE_EMPTY, coap_header_get_id(packet));
	if (err < 0) {
		LOG_ERR("coap_packet_init: %d", err);
		return err;
	}

	if (sendto(ep->sock, ack.data, ack.offset, 0, addr, addr_len) < 0) {
		LOG_ERR("sendto: %d", errno);
		return -errno;
	}

	return 0;
}

int coap_endpoint_reset(coap_endpoint *ep, struct coap_packet *packet, struct sockaddr *addr, socklen_t addr_len) {
	if (coap_header_get_type(packet) == COAP_TYPE_ACK || coap_header_get_type(packet) == COAP_TYPE_RESET) {
		LOG_ERR("coap_endpoint_reset must not be called for ACK or RESET packets");
		return -EINVAL;
	}

	struct coap_packet reset;
	u8_t data[4];
	int err = coap_packet_init(&reset, data, sizeof(data), 1, COAP_TYPE_RESET, 0, NULL, COAP_CODE_EMPTY, coap_header_get_id(packet));
	if (err < 0) {
		LOG_ERR("coap_packet_init: %d", err);
		return err;
	}

	if (sendto(ep->sock, reset.data, reset.offset, 0, addr, addr_len) < 0) {
		LOG_ERR("sendto: %d", errno);
		return -errno;
	}

	return 0;
}

int coap_endpoint_respond(coap_endpoint *ep, struct coap_packet *request, enum coap_response_code code, u8_t *payload, u16_t payload_len, struct sockaddr *addr, socklen_t addr_len) {
	struct coap_packet response;
	u8_t data[MAX_COAP_MSG_LEN];
	u8_t type = COAP_TYPE_ACK;
	if (coap_header_get_type(request) == COAP_TYPE_NON_CON) {
		type = COAP_TYPE_NON_CON;
	}
	u8_t token[8];
	int err = coap_packet_init(&response, data, sizeof(data), 1, type, coap_header_get_token(request, token), token, code, coap_header_get_id(request));
	if (err < 0) {
		LOG_ERR("coap_packet_init: %d", err);
		return err;
	}

	if (payload != NULL && payload_len > 0) {
		err = coap_packet_append_payload_marker(&response);
		if (err < 0) {
			LOG_ERR("coap_packet_append_payload_marker: %d", err);
			return err;
		}

		err = coap_packet_append_payload(&response, payload, payload_len);
		if (err < 0) {
			LOG_ERR("coap_packet_append_payload: %d", err);
			return err;
		}
	}

	if (sendto(ep->sock, response.data, response.offset, 0, addr, addr_len) < 0) {
		LOG_ERR("sendto: %d", errno);
		return -errno;
	}

	return 0;
}
```

## src/lte_helpers.h
```c
/**
 * @file lte_lc.h
 *
 * @brief Public APIs for the LTE Link Control driver.
 */

/*
 * Copyright (c) 2018 Nordic Semiconductor ASA
 *
 * SPDX-License-Identifier: LicenseRef-BSD-5-Clause-Nordic
 */
#ifndef ZEPHYR_INCLUDE_LTE_HELPERS_H_
#define ZEPHYR_INCLUDE_LTE_HELPERS_H_

#include <stdbool.h>

#ifdef __cplusplus
extern "C" {
#endif

int lte_lc_psm_get_with_cb(void);

#ifdef __cplusplus
}
#endif

#endif /* ZEPHYR_INCLUDE_LTE_HELPERS_H_ */
```
